## Kconfig
```kconfig
#
# For a description of the syntax of this configuration file,
# see Documentation/kbuild/kconfig-language.txt.
#
mainmenu "Cyclamen Configuration"

config KBUILD_VERBOSE
	bool "Increase build verbosity"

########################################
menu "Build"
########################################

config USE_GCC
	bool "Use a GCC or compatible compiler"

config CROSS_COMPILE
	string "Cross-compiler tool prefix"
	depends on USE_GCC
	help
	  Same as running 'make CROSS_COMPILE=prefix-' but stored for
	  default make runs in this kernel build directory.  You don't
	  need to set this unless you want the configured kernel build
	  directory to select the cross-compiler automatically.

config CC
	string "C compiler"
	depends on !USE_GCC
config AS
	string "Assembler"
	depends on !USE_GCC
config LD
	string "Linker"
	depends on !USE_GCC
config AR
	string "Object archiver"
	depends on !USE_GCC

#-#-#-#-#-#-#-#-#-#-#-#-#-#-#-#-#-#-#-#-

config MAKE_JOBS
	int "Number of parallel jobs"
	default 8
	help
	  Argument to pass to -j for make when building the toolchain.

config EXTRA_CCFLAGS
	string "Extra CCFLAGS"
	default "-O2"
	help
	  Extra compiler options for both C code.

endmenu

########################################
menu "Target"
########################################

config ROM_NATIVE
	string "ROM native"
	default y
	help
	  Builds cyclamen as ROM-native,
	  for using it as the boot ROM in a system.



endmenu

########################################
menu "Drivers"
########################################



endmenu
```
